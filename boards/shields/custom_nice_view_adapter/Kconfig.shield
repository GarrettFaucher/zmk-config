## boards/shields/custom_nice_view_adapter/Kconfig.shield
```kconfig
# Copyright (c) 2022 The ZMK Contributors
# SPDX-License-Identifier: MIT

config SHIELD_CUSTOM_NICE_VIEW_ADAPTER
    def_bool $(shields_list_contains,custom_nice_view_adapter)
```

## boards/shields/keyball61/Kconfig.defconfig
```kconfig
if SHIELD_KEYBALL61_RIGHT

config ZMK_KEYBOARD_NAME
    default "Keyball61"

config ZMK_SPLIT_ROLE_CENTRAL
    default y

endif

if SHIELD_KEYBALL61_RIGHT

config SPI
    default y

endif

if SHIELD_KEYBALL61_LEFT || SHIELD_KEYBALL61_RIGHT

config ZMK_SPLIT
    default y

config ZMK_POINTING
    default y

endif
```

## config/boards/shields/sofle/Kconfig.defconfig
```kconfig
# Copyright (c) 2020 Ryan Cross
# SPDX-License-Identifier: MIT

if SHIELD_SOFLE_DONGLE

config ZMK_KEYBOARD_NAME
    default "Sofle"

config ZMK_SPLIT_ROLE_CENTRAL
    default y

config ZMK_USB
    default y

endif

if SHIELD_SOFLE_LEFT || SHIELD_SOFLE_RIGHT || SHIELD_SOFLE_DONGLE

config ZMK_SPLIT
    default y

config ZMK_BLE
    default y

if ZMK_DISPLAY

config I2C
    default y

config SSD1306
    default y

config SSD1306_REVERSE_MODE
    default y

endif # ZMK_DISPLAY

if LVGL

config LV_Z_VDB_SIZE
    default 64

config LV_Z_DPI
    default 148

config LV_Z_BITS_PER_PIXEL
    default 1

choice LV_COLOR_DEPTH
    default LV_COLOR_DEPTH_1
endchoice

endif # LVGL

endif
```

## config/boards/shields/soflew/Kconfig.defconfig
```kconfig
# Copyright (c) 2020 Ryan Cross
# SPDX-License-Identifier: MIT

if SHIELD_SOFLEW_DONGLE

config ZMK_KEYBOARD_NAME
    string
    default "Sofle W"

config ZMK_SPLIT_ROLE_CENTRAL
    bool
    default y

config ZMK_USB
    bool
    default y

endif

if SHIELD_SOFLEW_LEFT || SHIELD_SOFLEW_RIGHT || SHIELD_SOFLEW_DONGLE

config ZMK_SPLIT
    bool
    default y

config ZMK_BLE
    bool
    default y

if ZMK_DISPLAY

config I2C
    bool
    default y

config SSD1306
    bool
    default y

config SSD1306_REVERSE_MODE
    bool
    default y

endif # ZMK_DISPLAY

if LVGL

config LV_Z_VDB_SIZE
    int
    default 64

config LV_Z_DPI
    int
    default 148

config LV_Z_BITS_PER_PIXEL
    int
    default 1

choice LV_COLOR_DEPTH
    default LV_COLOR_DEPTH_1
endchoice

endif # LVGL

endif
```

## config/boards/shields/soflew/Kconfig.shield
```kconfig
# Copyright (c) 2020 Ryan Cross
# SPDX-License-Identifier: MIT

config SHIELD_SOFLEW_DONGLE
    def_bool $(shields_list_contains,soflew_dongle)

config SHIELD_SOFLEW_LEFT
    def_bool $(shields_list_contains,soflew_left)

config SHIELD_SOFLEW_RIGHT
    def_bool $(shields_list_contains,soflew_right)
```

## config/west.yml
```yaml
manifest:
  remotes:
    - name: zmkfirmware
      url-base: https://github.com/zmkfirmware
    - name: garrettfaucher
      url-base: https://github.com/garrettfaucher
  projects:
    - name: zmk
      remote: zmkfirmware
      revision: main
      import: app/west.yml
    - name: zmk-dongle-display-091-oled
      remote: garrettfaucher
      revision: main
    - name: zmk-driver-pmw3360
      remote: garrettfaucher
      revision: invert-x-y
  self:
    path: config
```
